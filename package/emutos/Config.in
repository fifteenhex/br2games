## package/emutos/Config.in
```kconfig
config BR2_PACKAGE_EMUTOS
	bool "emutos (TOS ROM for Hatari)"
	depends on BR2_PACKAGE_HATARI
	help
	  EmuTOS is a free (GPL) replacement for the Atari TOS ROM. Installed
	  as Hatari's default TOS image (/usr/share/hatari/tos.img) so Atari ST
	  software can boot without a copyrighted ROM.

	  https://emutos.sourceforge.io
```

## package/mgba/Config.in
```kconfig
config BR2_PACKAGE_MGBA
	bool "mgba"
	depends on BR2_PACKAGE_SDL2
	select BR2_PACKAGE_ZLIB
	select BR2_PACKAGE_LIBPNG
	help
	  mGBA - Game Boy Advance emulator.

	  https://mgba.io
```

## package/retro-game-console-icons/Config.in
```kconfig
config BR2_PACKAGE_RETRO_GAME_CONSOLE_ICONS
	bool "retro game console icons"
	help
	  System/console icons (NES, Mega Drive, Game Boy, ...) from the
	  retro-game-console-icons project, downscaled to 128x128 and
	  installed under /usr/share/console-icons as <system>.png. lvshell
	  shows them on the per-system menu cards.

	  https://github.com/KyleBing/retro-game-console-icons
```

## package/scummvm-icons/Config.in
```kconfig
config BR2_PACKAGE_SCUMMVM_ICONS
	bool "ScummVM game icons"
	depends on BR2_PACKAGE_SCUMMVM
	help
	  Per-game cover icons from the scummvm-icons project, downscaled
	  to 96x96 and installed under /usr/share/scummvm/icons. lvshell
	  shows them next to each detected game.

	  https://github.com/scummvm/scummvm-icons
```
