## Config.in
```kconfig
config BR2_GAMES_SHOWBORKED
	bool "Show borken packages"
	help
	  Some packages are currently borken.
	  Show them..

source "$BR2_EXTERNAL_GAMES_PATH/package/bochs/Config.in"
source "$BR2_EXTERNAL_GAMES_PATH/package/cppquake/Config.in"
source "$BR2_EXTERNAL_GAMES_PATH/package/dosboxx/Config.in"
source "$BR2_EXTERNAL_GAMES_PATH/package/fake08/Config.in"
source "$BR2_EXTERNAL_GAMES_PATH/package/hatari/Config.in"
source "$BR2_EXTERNAL_GAMES_PATH/package/libfmt/Config.in"
source "$BR2_EXTERNAL_GAMES_PATH/package/lvshell/Config.in"
source "$BR2_EXTERNAL_GAMES_PATH/package/mednafen/Config.in"
source "$BR2_EXTERNAL_GAMES_PATH/package/mgba/Config.in"
source "$BR2_EXTERNAL_GAMES_PATH/package/pcem/Config.in"
source "$BR2_EXTERNAL_GAMES_PATH/package/picodrive/Config.in"
source "$BR2_EXTERNAL_GAMES_PATH/package/vice/Config.in"
source "$BR2_EXTERNAL_GAMES_PATH/package/xa/Config.in"
source "$BR2_EXTERNAL_GAMES_PATH/package/cdogssdl/Config.in"
source "$BR2_EXTERNAL_GAMES_PATH/package/wipeout-rewrite/Config.in"

# SCUMMVM
source "$BR2_EXTERNAL_GAMES_PATH/package/scummvm/Config.in"
source "$BR2_EXTERNAL_GAMES_PATH/package/samnmaxdemo/Config.in"
```

## package/cdogssdl/Config.in
```kconfig
config BR2_PACKAGE_CDOGSSDL
	bool "cdogssdl"
	depends on BR2_PACKAGE_SDL2
	depends on BR2_PACKAGE_SDL2_IMAGE
	depends on BR2_PACKAGE_SDL2_MIXER
	help
	  cdogs-sdl
```

## package/cppquake/Config.in
```kconfig
config BR2_PACKAGE_CPPQUAKE
	bool "cppquake"
	depends on BR2_GAMES_SHOWBORKED
	depends on BR2_PACKAGE_SDL2
	select BR2_PACKAGE_LIBFMT
	select BR2_PACKAGE_GLM
	help
	  Modernised fork of SDLQuake
```

## package/dosboxx/Config.in
```kconfig
config BR2_PACKAGE_DOSBOXX
	bool "dosbox-x"
	depends on BR2_PACKAGE_SDL2
	select BR2_PACKAGE_ZLIB
	help
	  dosbox-x
```

## package/fake08/Config.in
```kconfig
config BR2_PACKAGE_FAKE08
	bool "fake-08"
	depends on BR2_PACKAGE_SDL2
	depends on BR2_INSTALL_LIBSTDCPP
	help
	  fake-08
```

## package/hatari/Config.in
```kconfig
config BR2_PACKAGE_HATARI
	bool "hatari"
	depends on BR2_PACKAGE_SDL2
	help
	  hatari
```

## package/lvshell/Config.in
```kconfig
config BR2_PACKAGE_LVSHELL
	bool "lvshell"
	depends on BR2_PACKAGE_SDL2
	help
	  LVGL based shell to start apps.
```

## package/mednafen/Config.in
```kconfig
config BR2_PACKAGE_MEDNAFEN
	bool "mednafen"
	select BR2_PACKAGE_ZLIB
	help
	  mednafen
```

## package/pcem/Config.in
```kconfig
config BR2_PACKAGE_PCEM
	bool "pcem"
	depends on BR2_GAMES_SHOWBORKED
	depends on BR2_PACKAGE_SDL2
	select BR2_PACKAGE_HOST_CMAKE
	select BR2_PACKAGE_HOST_DOS2UNIX
	select BR2_PACKAGE_OPENAL
	help
	  PCEM
```

## package/picodrive/Config.in
```kconfig
config BR2_PACKAGE_PICODRIVE
	bool "picodrive"
	depends on BR2_PACKAGE_SDL
	select BR2_PACKAGE_LIBPNG
	help
	  Picodrive
```

## package/samnmaxdemo/Config.in
```kconfig
config BR2_PACKAGE_SAMNMAXDEMO
	bool "Sam & Max Hit the Road demo"
	depends on BR2_PACKAGE_SCUMMVM
	help
	  Demo version of Sam & Max Hit the Road for SCUMMVM
```

## package/scummvm/Config.in
```kconfig
config BR2_PACKAGE_SCUMMVM
	bool "scummvm"
	depends on BR2_TOOLCHAIN_BUILDROOT_CXX
	depends on BR2_PACKAGE_SDL || BR2_PACKAGE_SDL2
	select BR2_PACKAGE_ALSA_LIB_HWDEP if BR2_PACKAGE_ALSA_LIB=y
	select BR2_PACKAGE_ALSA_LIB_SEQ if BR2_PACKAGE_ALSA_LIB=y
	help
	  I likes me some monkey island

config BR2_PACKAGE_SCUMMVM_DISABLE_SCALERS
	bool "disable scalers"
	depends on BR2_PACKAGE_SCUMMVM
	help
	  Disable scalers

config BR2_PACKAGE_SCUMMVM_ENGINE_SCUMMV7V8
	bool "scummvm v7/v8 suppport"
	depends on BR2_PACKAGE_SCUMMVM
	help
	  Support for newer scumm games like Full Throttle.
```

## package/vice/Config.in
```kconfig
config BR2_PACKAGE_VICE
	bool "vice"
	depends on BR2_TOOLCHAIN_BUILDROOT_CXX
	depends on BR2_PACKAGE_SDL2
	select BR2_PACKAGE_HOST_XA
	select BR2_PACKAGE_SDL2_IMAGE
	help
	  vice
```

## package/wipeout-rewrite/Config.in
```kconfig
config BR2_PACKAGE_WIPEOUT_REWRITE
	bool "wipeout-rewrite"
	depends on BR2_PACKAGE_SDL2
	depends on BR2_PACKAGE_LIBGLEW
	help
	  wipeout_rewrite
```
